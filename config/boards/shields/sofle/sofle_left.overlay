#include <dt-bindings/gpio/gpio.h>

/ {
    sensors {
        compatible = "zmk,keymap-sensors";

        encoder_left: encoder_left {
            compatible = "alps,ec11";
            a-gpios = <&pro_micro 29 (GPIO_ACTIVE_LOW | GPIO_PULL_UP)>;
            b-gpios = <&pro_micro 31 (GPIO_ACTIVE_LOW | GPIO_PULL_UP)>;
        };
    };
};