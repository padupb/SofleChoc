#include <dt-bindings/gpio/gpio.h>

/ {
    sensors {
        compatible = "zmk,keymap-sensors";
    };

    left_encoder: left_encoder {
        compatible = "alps,ec11";
        a-gpios = <&gpio0 31 (GPIO_ACTIVE_LOW | GPIO_PULL_UP)>;
        b-gpios = <&gpio0 29 (GPIO_ACTIVE_LOW | GPIO_PULL_UP)>;
        steps = <4>;
        status = "disabled";
    };

    right_encoder: right_encoder {
        compatible = "alps,ec11";
        a-gpios = <&gpio0 31 (GPIO_ACTIVE_LOW | GPIO_PULL_UP)>;
        b-gpios = <&gpio0 29 (GPIO_ACTIVE_LOW | GPIO_PULL_UP)>;
        steps = <4>;
        status = "disabled";
    };
};