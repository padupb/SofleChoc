/ {
    sensors {
        compatible = "zmk,keymap-sensors";

        encoder_right: encoder_right {
            compatible = "alps,ec11";
            a-gpios = <&pro_micro 16 GPIO_ACTIVE_HIGH>;
            b-gpios = <&pro_micro 10 GPIO_ACTIVE_HIGH>;
        };
    };
};